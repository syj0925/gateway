/********************************************************************************
**
** 文件名:     debug_tool.c
** 版权所有:   
** 文件描述:   该模块主要实现一些调试用到的打印信息工具
**
*********************************************************************************
**             修改历史记录
**===============================================================================
**| 日期       | 作者   |  修改记录
**===============================================================================
**| 2011/11/26 | 苏友江 |  创建第一版本
*********************************************************************************/
#if 0
#include "bsp.h"
#include "sys_includes.h"

static void _put_char(INT8U ch)
{
	while(USART_GetFlagStatus(USART1, USART_FLAG_TC)==RESET);
	USART_SendData(USART1, ch);
}

INT8U hex_to_char(INT8U sbyte)
{
    sbyte &= 0x0F;
    if (sbyte < 0x0A) return (sbyte + '0');
    else return (sbyte - 0x0A + 'A');
}

/*******************************************************************
** 函数名:     printf_hex
** 函数描述:   串口格式化输出数据
** 参数:       [in] pdata:  数据指针
** 参数:       [in] len:    数据长度
** 返回:       无
********************************************************************/
void printf_hex(INT8U *pdata, INT16U len)
{
    INT8U ch;
    
    if (pdata == NULL || len == 0) {
        return;
    }
    if (len > 200) {
        len = 200;
    }

    while (len--) {
        ch = *pdata++;
        _put_char(hex_to_char((INT8U)(ch >> 4)));
        _put_char(hex_to_char(ch));
        _put_char(' ');
    }
}
#endif
